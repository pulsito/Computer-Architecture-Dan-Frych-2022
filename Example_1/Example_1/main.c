#include "main.h"
//ініціалізуємо змінні для відліку часу (задаємо таймер)
unsigned char sec = 10;
unsigned char min = 0;
unsigned char hour = 1;
unsigned char overflow = 0;
unsigned char state = 0; //Статус 1 означає що таймер завершив роботу

void port_init(void)  //Створюємо функцію ініціалізації порту D
{
	PORTD=0x00;	//Ініціалізуємо порт D логічним 0
	DDRD=0xFF;	//Встановляємо порту D режим виходу
}

ISR (TIMER2_OVF_vect)//Реалізуємо функцію переривання
{
	if(!state)	//Якщо таймер працює
	{
		overflow++;				//при кожному переповненні інкрементуємо змінну лічильника
		if (overflow>=30)		//кожні 30 тактів = 1 секунді
		{
			if(sec == 0 && (min>0||hour>0))	//Якщо секунди дійшли до нуля, але хвлини чи години ще залишилися, віднімаємо хвилину, секунди ставимо на 60
			{
				sec=60;
				if(min == 0) //Якщо хвилини теж = 0, віднімаємо годину, хвилини ставимо на 60
				{
					min=60;
					hour--;
				}
				min--;
			}
			
			
			sec--;
			overflow=0x00;
		}
	}
}

int main(void)
{
	port_init();		// Ініціалізуємо порт D
	lcd_init();			// Ініціалізуємо дисплей
	TIMSK |= (1<< TOIE2);	// Дозвіл переривання від переповнення
	TCCR2 |= (1<< CS22)|(1<< CS20); // Задаємо значення переддільника
	SREG |= (1<<7);		// Дозвіл глобального переривання

	while(1)
	{
		setpos(0,0);	// Задаємо позицію курсора
		if(sec<=0 && min <= 0 && hour<=0)	//Перевіряємо чи не закінчився час таймеру
		{
			send_str("Timer completed   ");
			state = 1;						//Завершуємо роботу
		}
		else
		{
			send_time(sec,min, hour);	// Виводимо поточний час
		}
		
		
	}
}
